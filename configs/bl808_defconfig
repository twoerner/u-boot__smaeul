## configs/bl808_defconfig
```kconfig
CONFIG_RISCV=y
CONFIG_TEXT_BASE=0x50100000
CONFIG_DEFAULT_DEVICE_TREE="bl808"
CONFIG_SPL_TEXT_BASE=0x22020000
CONFIG_SPL_MMC=y
CONFIG_SPL_SIZE_LIMIT=0x00034000
CONFIG_SPL_SIZE_LIMIT_PROVIDE_STACK=0x1000
CONFIG_SPL=y
CONFIG_SYS_LOAD_ADDR=0x50100000
CONFIG_TARGET_BOUFFALO_BL808=y
CONFIG_SPL_OPENSBI_LOAD_ADDR=0x50000000
CONFIG_RISCV_SMODE=y
# CONFIG_OF_BOARD_FIXUP is not set
CONFIG_HAS_CUSTOM_SYS_INIT_SP_ADDR=y
CONFIG_CUSTOM_SYS_INIT_SP_ADDR=0x50100000
CONFIG_FIT=y
# CONFIG_FIT_FULL_CHECK is not set
# CONFIG_FIT_PRINT is not set
# CONFIG_BOOTSTD is not set
# CONFIG_LEGACY_IMAGE_FORMAT is not set
CONFIG_DYNAMIC_SYS_CLK_FREQ=y
# CONFIG_AUTOBOOT is not set
CONFIG_SYS_CONSOLE_INFO_QUIET=y
CONFIG_SPL_SIZE_LIMIT_SUBTRACT_GD=y
CONFIG_SPL_SIZE_LIMIT_SUBTRACT_MALLOC=y
# CONFIG_SPL_HAS_BSS_LINKER_SECTION is not set
CONFIG_SPL_NO_BSS_LIMIT=y
CONFIG_SPL_SYS_REPORT_STACK_F_USAGE=y
# CONFIG_SPL_BINMAN_SYMBOLS is not set
# CONFIG_SPL_RAW_IMAGE_SUPPORT is not set
# CONFIG_SPL_SHARES_INIT_SP_ADDR is not set
CONFIG_SPL_STACK=0x22054000
# CONFIG_SPL_SEPARATE_BSS is not set
CONFIG_SYS_SPL_MALLOC=y
CONFIG_HAS_CUSTOM_SPL_MALLOC_START=y
CONFIG_CUSTOM_SYS_SPL_MALLOC_ADDR=0x50200000
CONFIG_SPL_FS_EXT4=y
CONFIG_SPL_OPENSBI_SCRATCH_OPTIONS=0x0
# CONFIG_SYS_LONGHELP is not set
# CONFIG_SYS_XTRACE is not set
# CONFIG_CMD_BDI is not set
# CONFIG_CMD_CONSOLE is not set
# CONFIG_CMD_CPU is not set
# CONFIG_CMD_BOOTD is not set
# CONFIG_CMD_BOOTM is not set
# CONFIG_CMD_BOOTI is not set
# CONFIG_CMD_ELF is not set
# CONFIG_CMD_IMI is not set
# CONFIG_CMD_XIMG is not set
# CONFIG_CMD_EXPORTENV is not set
# CONFIG_CMD_IMPORTENV is not set
# CONFIG_CMD_EDITENV is not set
# CONFIG_CMD_SAVEENV is not set
# CONFIG_CMD_ENV_EXISTS is not set
# CONFIG_CMD_CRC32 is not set
CONFIG_CMD_GPIO=y
# CONFIG_CMD_LOADB is not set
# CONFIG_CMD_LOADS is not set
CONFIG_CMD_MMC=y
# CONFIG_CMD_PINMUX is not set
# CONFIG_CMD_ECHO is not set
# CONFIG_CMD_ITEST is not set
# CONFIG_CMD_SOURCE is not set
# CONFIG_CMD_SETEXPR is not set
# CONFIG_CMD_SLEEP is not set
CONFIG_CMD_FS_GENERIC=y
# CONFIG_CMD_CYCLIC is not set
CONFIG_EFI_PARTITION=y
# CONFIG_PARTITION_UUIDS is not set
# CONFIG_SPL_PARTITION_UUIDS is not set
CONFIG_SPL_OF_EMBED=y
CONFIG_OF_SPL_REMOVE_PROPS=""
# CONFIG_NET is not set
# CONFIG_DM_DEVICE_REMOVE is not set
# CONFIG_BLOCK_CACHE is not set
CONFIG_SPL_CLK=y
# CONFIG_I2C is not set
# CONFIG_INPUT is not set
CONFIG_MMC=y
CONFIG_MMC_BROKEN_CD=y
CONFIG_MMC_SDHCI=y
CONFIG_MMC_SDHCI_BFLB=y
# CONFIG_MTD is not set
CONFIG_PINCTRL=y
CONFIG_PINCONF=y
# CONFIG_PINCONF_RECURSIVE is not set
CONFIG_SPL_PINCTRL=y
CONFIG_SPL_PINCONF=y
# CONFIG_SPL_PINCONF_RECURSIVE is not set
CONFIG_PINCTRL_BFLB=y
# CONFIG_POWER is not set
CONFIG_RAM=y
CONFIG_SPL_RAM=y
# CONFIG_RAM_SIFIVE is not set
CONFIG_DM_RESET=y
CONFIG_SYSRESET=y
# CONFIG_WATCHDOG is not set
CONFIG_WDT=y
CONFIG_FS_EXT4=y
# CONFIG_BINMAN_FDT is not set
# CONFIG_SPL_USE_TINY_PRINTF is not set
# CONFIG_SHA256 is not set
# CONFIG_SPL_SHA1 is not set
# CONFIG_GZIP is not set
# CONFIG_EFI_LOADER is not set
# CONFIG_LMB is not set
```
